## components/freertos_module/Kconfig
```kconfig
# Kconfig para o módulo FreeRTOS

menu "FreeRTOS Module Configuration"

    config FREERTOS_MODULE_ENABLED
        bool "Enable FreeRTOS Module"
        default y
        help
            Habilita o módulo de demonstração FreeRTOS com tarefas, mutex e queue.

    config FREERTOS_MODULE_PRODUCER_TASK_STACK_SIZE
        int "Producer Task Stack Size"
        default 4096
        range 1024 8192
        depends on FREERTOS_MODULE_ENABLED
        help
            Tamanho da stack para a tarefa do produtor.

    config FREERTOS_MODULE_CONSUMER_TASK_STACK_SIZE
        int "Consumer Task Stack Size"
        default 4096
        range 1024 8192
        depends on FREERTOS_MODULE_ENABLED
        help
            Tamanho da stack para a tarefa do consumidor.

    config FREERTOS_MODULE_QUEUE_SIZE
        int "Queue Size"
        default 10
        range 5 20
        depends on FREERTOS_MODULE_ENABLED
        help
            Tamanho da fila de mensagens.
endmenu 
```

## sdkconfig.defaults
```kconfig
# Ativa o subsistema Bluetooth
CONFIG_BT_ENABLED=y

# Configura para usar APENAS BLE (economiza RAM no C3)
CONFIG_BT_CONTROLLER_ENABLED=y
CONFIG_BT_BLE_42_FEATURES_SUPPORTED=y

# Escolhe o NimBLE como Host (Desliga o Bluedroid)
CONFIG_BT_BLUEDROID_ENABLED=n
CONFIG_BT_NIMBLE_ENABLED=y

# (Opcional) Aumenta o tamanho da stack para evitar travamentos
CONFIG_ESP_MAIN_TASK_STACK_SIZE=4096
```
